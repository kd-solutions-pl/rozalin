## meta-rozalin/conf/distro/rozalin.conf
```bitbake
DISTRO_NAME = "Rozalin"
DISTRO_VERSION = "1.0"

INIT_MANAGER = "systemd"
DISTRO_FEATURES = "systemd ipv4 ipv6 wifi zeroconf usbgadget usbhost pni-names"
```

## meta-rozalin/conf/machine/imx91sfrdm.conf
```bitbake
require conf/machine/include/arm/armv8-2a/tune-cortexa55.inc

MACHINE_FEATURES = "usbhost usbgadget alsa serial"

SERIAL_CONSOLES = "115200;ttyLP0"

PREFERRED_PROVIDER_virtual/kernel = "linux-rozalin"
PREFERRED_PROVIDER_trusted-firmware-a = "nxp-trusted-firmware-a"
PREFERRED_PROVIDER_optee-os = "nxp-optee-os"
PREFERRED_PROVIDER_optee-os-tadevkit = "nxp-optee-os-tadevkit"
PREFERRED_PROVIDER_optee-examples = "nxp-optee-examples"
KERNEL_DEVICETREE = "freescale/imx91-11x11-frdm-s.dtb"
KERNEL_IMAGETYPE = "Image"

SECO_FIRMWARE_NAME = "mx91a0-ahab-container.img"

PREFERRED_PROVIDER_virtual/bootloader ?= "u-boot-rozalin"
EXTRA_IMAGEDEPENDS += "virtual/bootloader"
MACHINE_ESSENTIAL_EXTRA_RDEPENDS = "kernel-devicetree"
UBOOT_CONFIG ??= "nand"
UBOOT_CONFIG[nand] = "imx91s_11x11_frdm_defconfig"

MACHINE_ESSENTIAL_EXTRA_RDEPENDS += " \
    kernel-module-dwmac-imx \
    kernel-module-imx7ulp-wdt \
    kernel-module-imx93-adc \
    kernel-module-nvmem-imx-ocotp-ele \
    kernel-module-nxp-bbnsm-pwrkey \
    kernel-module-qoriq-thermal \
    kernel-module-reset-gpio \
    kernel-module-rtc-nxp-bbnsm \
    kernel-module-rtc-pcf2127 \
    kernel-module-tcpci \
    kernel-module-nxp-wlan \
    firmware-nxp-wifi-nxpiw610-sdio \
    firmware-nxp-wifi-conf \
"

IMAGE_BOOT_FILES ?= " \
    ${KERNEL_IMAGETYPE} \
    ${@os.path.basename(d.getVar("KERNEL_DEVICETREE"))} \
"
MKUBIFS_ARGS = "-m 2048 -e 126976 -c 1536"
UBINIZE_ARGS = "-m 2048 -p 128KiB -s 2048"
IMAGE_FSTYPES:append = " ubifs squashfs"
EXTRA_IMAGEDEPENDS += "factory-provisioning-tools"
```

## meta-rozalin/conf/machine/imx93frdm.conf
```bitbake
# Generate an extlinux configuration file
UBOOT_EXTLINUX = "1"
UBOOT_EXTLINUX_ROOT ?= "root=/dev/mmcblk0p2"
# Install the extlinux conf file in /boot, and also the device tree it needs
MACHINE_ESSENTIAL_EXTRA_RDEPENDS = "u-boot-rozalin kernel-devicetree"

# Install kernel modules if they are enabled
MACHINE_ESSENTIAL_EXTRA_RRECOMMENDS = "kernel-modules"

# Generate a bootable uSD card image using wic. Also generate a bmap file
# to speed up writing to a card by avoiding to write uninitialized data.
WKS_FILE = "${MACHINE}.wks.in"
IMAGE_FSTYPES:append = " wic wic.bmap"

require conf/machine/include/arm/armv8-2a/tune-cortexa55.inc

MACHINE_FEATURES = "usbhost usbgadget alsa serial"

SERIAL_CONSOLES = "115200;ttyLP0"

PREFERRED_PROVIDER_virtual/kernel = "linux-rozalin"
PREFERRED_PROVIDER_trusted-firmware-a = "trusted-firmware-a"
PREFERRED_PROVIDER_optee-os = "optee-os"
PREFERRED_PROVIDER_optee-os-tadevkit = "optee-os-tadevkit"
PREFERRED_PROVIDER_optee-examples = "optee-examples"
KERNEL_DEVICETREE = "freescale/imx93-11x11-frdm.dtb"
KERNEL_IMAGETYPE = "Image"

COMPATIBLE_MACHINE:pn-optee-examples = "^imx93frdm$"

SECO_FIRMWARE_NAME = "mx93a1-ahab-container.img"

IMX_BOOT_SEEK = "32"

PREFERRED_PROVIDER_virtual/bootloader ?= "u-boot-rozalin"
MACHINE_ESSENTIAL_EXTRA_RDEPENDS = "u-boot-rozalin-extlinux kernel-devicetree"
UBOOT_CONFIG ??= "sd"
UBOOT_CONFIG[sd] = "imx93_frdm_defconfig"
UBOOT_CONFIG_IMAGE_FSTYPES[sd] = "sdcard"

MACHINE_ESSENTIAL_EXTRA_RDEPENDS += " \
    kernel-module-adp5585 \
    kernel-module-dwmac-imx \
    kernel-module-flexcan \
    kernel-module-imx7ulp-wdt \
    kernel-module-imx93-adc \
    kernel-module-nvmem-imx-ocotp-ele \
    kernel-module-nxp-bbnsm-pwrkey \
    kernel-module-qoriq-thermal \
    kernel-module-reset-gpio \
    kernel-module-rtc-nxp-bbnsm \
    kernel-module-rtc-pcf2127 \
    kernel-module-spidev \
    kernel-module-tcpci \
    kernel-module-nxp-wlan \
    firmware-nxp-wifi-nxpiw612-sdio \
    firmware-nxp-wifi-conf \
"

IMAGE_BOOT_FILES ?= " \
    ${KERNEL_IMAGETYPE} \
    ${@os.path.basename(d.getVar("KERNEL_DEVICETREE"))} \
"
```
